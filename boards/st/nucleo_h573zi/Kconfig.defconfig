## boards/st/nucleo_h573zi/Kconfig.defconfig
```kconfig
# STM32H563ZI Nucleo board configuration

# Copyright (c) 2023 Thomas Stranger
# SPDX-License-Identifier: Apache-2.0

if BOARD_NUCLEO_H573ZI

if NETWORKING

config NET_L2_ETHERNET
	default y

endif # NETWORKING

if BUILD_WITH_TFM

# Initial Attestation key provisioned by the BL1 bootloader
config TFM_INITIAL_ATTESTATION_KEY
	default y

config TFM_DUMMY_PROVISIONING
	default n

endif # BUILD_WITH_TFM
	
config TFM_BOARD
	string
	default "stm/nucleo_h573zi"

endif # BOARD_NUCLEO_H573ZI
```

## boards/st/nucleo_h573zi/Kconfig.nucleo_h573zi
```kconfig
# Copyright (c) 2023 Thomas Stranger
# SPDX-License-Identifier: Apache-2.0

config BOARD_NUCLEO_H573ZI
	select SOC_STM32H573XX
```

## boards/st/nucleo_h573zi/board.yml
```yaml
board:
  name: nucleo_h573zi
  vendor: st
  socs:
    - name: stm32h573xx
      variants:
      - name: ns
```
